## board/freescale/mx6ullfargo/Kconfig
```kconfig
if TARGET_MX6ULL_9X9_FARGO

config SYS_BOARD
	default "mx6ullfargo"

config SYS_VENDOR
	default "freescale"


config SYS_CONFIG_NAME
	default "mx6ullfargo"

endif
```
